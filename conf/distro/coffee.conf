## conf/distro/coffee.conf
```bitbake
require conf/distro/poky.conf
DISTRO = "coffee"
DISTRO_NAME = "Coffee (Yocto/Poky based embedded Linux distribution)"
DISTRO_VERSION = "1.0"
DISTRO_CODENAME = "honister"
SDK_VENDOR = "-sdk"
SDK_VERSION := "${@d.getVar('DISTRO_VERSION')}"
MAINTAINER = "Matthias Klein <matthias@extraklein.de>"

# Do not build runtime tests; results in a dependency to gnome-desktop-testing
DISTRO_FEATURES:remove = "ptest"

DISTRO_FEATURES:remove = "x11 wayland directfb vulkan opengl 3g nfc nfs zeroconf"

# use systemd and disable sysvinit
DISTRO_FEATURES:append = " systemd"
VIRTUAL-RUNTIME_init_manager = "systemd"
DISTRO_FEATURES_BACKFILL_CONSIDERED = "sysvinit"
VIRTUAL-RUNTIME_initscripts = ""

# Append to kernel command line
APPEND:append = ' init=/sbin/init-overlay'

ROOT_HOME ?= "/sdi"

# Create /etc/build file with commit ids of all yocto layers
INHERIT += "image-buildinfo"

SDKIMAGE_FEATURES = "dev-pkgs dbg-pkgs doc-pkgs staticdev-pkgs"
```

## conf/layer.conf
```bitbake
# We have a conf and classes directory, add to BBPATH
BBPATH .= ":${LAYERDIR}"

# We have recipes-* directories, add to BBFILES
BBFILES += "${LAYERDIR}/recipes-*/*/*.bb \
            ${LAYERDIR}/recipes-*/*/*.bbappend"

BBFILE_COLLECTIONS += "meta-distro-coffee"
BBFILE_PATTERN_meta-distro-coffee = "^${LAYERDIR}/"
BBFILE_PRIORITY_meta-distro-coffee = "6"

LAYERDEPENDS_meta-distro-coffee = "core"
LAYERSERIES_COMPAT_meta-distro-coffee = "kirkstone"
```
